## meta-megabit/conf/layer.conf
```bitbake
# We have a conf and classes directory, add to BBPATH
BBPATH .= ":${LAYERDIR}"

# We have recipes-* directories, add to BBFILES
BBFILES += "${LAYERDIR}/recipes-*/*/*.bb \
            ${LAYERDIR}/recipes-*/*/*.bbappend"

BBFILE_COLLECTIONS += "meta-megabit"
BBFILE_PATTERN_meta-megabit = "^${LAYERDIR}/"
BBFILE_PRIORITY_meta-megabit = "6"

LAYERDEPENDS_meta-megabit = "core"
LAYERSERIES_COMPAT_meta-megabit = "scarthgap"
```
